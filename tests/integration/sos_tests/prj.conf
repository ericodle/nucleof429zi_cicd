## CMakeLists.txt
```
cmake_minimum_required(VERSION 3.20.0)
find_package(Zephyr REQUIRED HINTS $ENV{ZEPHYR_BASE})
project(sos_tests)

target_sources(app PRIVATE src/main.c)
```

## prj.conf
```kconfig
CONFIG_ZTEST=y
CONFIG_NRFX_CLOCK_LFXO_TWO_STAGE_ENABLED=n
```

## src/main.c
```c
/*
TODO: write actual unit tests for SOS and get these tests to run on simulated hardware.
 */

 #include <zephyr/ztest.h>


 ZTEST_SUITE(framework_tests, NULL, NULL, NULL, NULL, NULL);
 
 /**
  * @brief Test Asserts
  *
  * This test verifies various assert macros provided by ztest.
  *
  */
 ZTEST(framework_tests, test_assert)
 {
     zassert_true(1, "1 was false");
     zassert_false(0, "0 was true");
     zassert_is_null(NULL, "NULL was not NULL");
     zassert_not_null("foo", "\"foo\" was NULL");
     zassert_equal(1, 1, "1 was not equal to 1");
     zassert_equal_ptr(NULL, NULL, "NULL was not equal to NULL");
 }
```
