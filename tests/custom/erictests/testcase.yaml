## tests/custom/erictests/testcase.yaml
```yaml
tests:
  custom.erictests:
    build_only: false
    platform_allow:
      - native_posix
      - native_sim
    integration_platforms:
      - native_sim
    tags: test_framework
```

## tests/custom/sos_tests/testcase.yaml
```yaml
tests:
  custom.sos_tests:
    build_only: false
    platform_allow:
      - native_posix
      - native_sim
    integration_platforms:
      - native_sim
    tags: test_framework
```

## tests/erictests/testcase.yaml
```yaml
common:
  tags: CICD
  integration_platforms:
    - nucleo_f429zi

tests:
  erictests: {}
```

## tests/hardware_sim/print_test/testcase.yaml
```yaml
tests:
  hardware_sim.print_test:
    build_only: false
    platform_allow:
      - qemu_cortex_m3
    integration_platforms:
      - qemu_cortex_m3
    tags: test_framework
```

## tests/integration/confirmation_tests/testcase.yaml
```yaml
tests:
  integration.confirmation_tests:
    build_only: false
    platform_allow:
      - qemu_cortex_m0
    integration_platforms:
      - qemu_cortex_m0
    tags: test_framework
```

## tests/integration/sos_tests/testcase.yaml
```yaml
tests:
  integration.sos_tests:
    build_only: false
    platform_allow:
      - nucleo_f429zi
    integration_platforms:
      - nucleo_f429zi
    tags: test_framework
```

## tests/lib/custom/testcase.yaml
```yaml
common:
  tags: CICD
  integration_platforms:
    - nucleo_f429zi

tests:
  lib.custom: {}
  lib.custom.non_default:
    extra_args: CONFIG_CUSTOM_GET_VALUE_DEFAULT=6
```

## tests/ztest/validate/testcase.yaml
```yaml
tests:
  ztest.validate:
    build_only: false
    platform_allow:
      - native_posix
      - native_sim
    integration_platforms:
      - native_sim
    tags: test_framework
```
