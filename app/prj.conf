## CMakeLists.txt
```
#-------------------------------------------------------------------------------
# Zephyr nucleof429zi_cicd app
#
# Copyright (c) 2021 Nordic Semiconductor ASA
# SPDX-License-Identifier: Apache-2.0

cmake_minimum_required(VERSION 3.22.0)
find_package(Zephyr REQUIRED HINTS $ENV{ZEPHYR_BASE})

project(app LANGUAGES C)

# Add main.c and morse.c to the list of source files
target_sources(app PRIVATE src/main.c src/morse.c)
```

## sample.yaml
```
# This file is provided so that the application can be compiled using Twister,
# the Zephyr testing tool. In this file, multiple combinations can be specified,
# so that you can easily test all of them locally or in CI.
sample:
  description: Your nucleof429zi_cicd app
  name: nucleof429zi_cicd 
common:
  build_only: true
  integration_platforms:
    - nucleo_f429zi
tests:
  app.default: {}
  app.debug:
    extra_overlay_confs:
      - debug.conf
```

## prj.conf
```kconfig
# Enable GPIO driver support
CONFIG_GPIO=y
```

## src/main.c
```c
// app/src/main.c
#include <stdio.h>
#include <zephyr/kernel.h>
#include <zephyr/drivers/gpio.h>
#include "morse.h"

int main(void) {
    int ret;
    
    printf("Your app for the NUCLEO-F429ZI is working!\n");

    if (!gpio_is_ready_dt(&led)) {
        printf("Error: GPIO device is not ready\n");
        return 0;
    }

    ret = gpio_pin_configure_dt(&led, GPIO_OUTPUT_ACTIVE);
    if (ret < 0) {
        printf("Error: Failed to configure LED pin\n");
        return 0;
    }

    while (1) {
        blink_sos();
    }

    return 0;
}
```

## src/morse.c
```c
// morse.c
#include "morse.h"

#define LED0_NODE DT_ALIAS(led0)
const struct gpio_dt_spec led = GPIO_DT_SPEC_GET(LED0_NODE, gpios);

void blink_led(int duration) {
    gpio_pin_set_dt(&led, 1);
    k_msleep(duration);
    gpio_pin_set_dt(&led, 0);
    k_msleep(GAP_TIME_MS);
}

void blink_sos() {
    int sos_pattern[] = {DOT_TIME_MS, DOT_TIME_MS, DOT_TIME_MS,  
                         DASH_TIME_MS, DASH_TIME_MS, DASH_TIME_MS,
                         DOT_TIME_MS, DOT_TIME_MS, DOT_TIME_MS};
    
    for (int i = 0; i < 9; i++) {
        blink_led(sos_pattern[i]);
        if (i == 2 || i == 5) {
            k_msleep(LETTER_GAP_MS);
        }
    }
    k_msleep(WORD_GAP_MS);
}
```

## src/morse.h
```c
// morse.h
#ifndef MORSE_H
#define MORSE_H

#include <zephyr/kernel.h>
#include <zephyr/drivers/gpio.h>

#define DOT_TIME_MS 200   // Duration of a dot
#define DASH_TIME_MS 600  // Duration of a dash (3x dot time)
#define GAP_TIME_MS 200   // Gap between elements
#define LETTER_GAP_MS 600 // Gap between letters
#define WORD_GAP_MS 1400  // Gap between words

extern const struct gpio_dt_spec led;

void blink_led(int duration);
void blink_sos(void);

#endif // MORSE_H
```
